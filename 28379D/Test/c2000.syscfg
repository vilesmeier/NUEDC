/**
 * @cliArgs --device "F2837xD" --part "F2837xD_176PTP" --package "F2837xD_176PTP" --context "CPU1" --product "C2000WARE@5.05.00.00"
 * @versions {"tool":"1.24.0+4110"}
 */

/**
 * Import the modules used in this configuration.
 */
const adc  = scripting.addModule("/driverlib/adc.js", {}, false);
const adc1 = adc.addInstance();

/**
 * Write custom configuration values to the imported modules.
 */
adc1.$name             = "myADC3";
adc1.adcBase           = "ADCD_BASE";
adc1.adcClockPrescaler = "ADC_CLK_DIV_4_0";
adc1.adcSignalMode     = "ADC_MODE_DIFFERENTIAL";
adc1.adcResolutionMode = "ADC_RESOLUTION_16BIT";
adc1.soc1Channel       = "ADC_CH_ADCIN2_ADCIN3";
adc1.enabledSOCs       = ["ADC_SOC_NUMBER0"];
adc1.soc0Channel       = "ADC_CH_ADCIN4_ADCIN5";
